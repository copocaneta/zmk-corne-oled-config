## config/west.yml
```yaml
manifest:
  remotes:
    - name: zmkfirmware
      url-base: https://github.com/zmkfirmware
    - name: copocaneta
      url-base: https://github.com/copocaneta
  projects:
    - name: zmk
      remote: zmkfirmware
      revision: v0.3.0
      import: app/west.yml
    - name: zmk-nice-oled
      remote: copocaneta
      revision: 1bde1b5ced006a3d5514f7c2eeabf94fa6eee5c3
  self:
    path: config
```
